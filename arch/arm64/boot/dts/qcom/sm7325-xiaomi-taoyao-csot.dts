// SPDX-License-Identifier: (GPL-2.0+ OR BSD-3-Clause)
/*
 * Copyright (c) 2025, Stanislav Zaikin <zstaseg@gmail.com>
 */

/dts-v1/;

#include "sm7325-xiaomi-taoyao-common.dtsi"

/ {
	model = "Xiaomi 12 Lite 5G (CSOT)";
	compatible = "xiaomi,taoyao", "qcom,sm7325";
};
